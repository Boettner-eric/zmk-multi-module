## boards/shields/multi/Kconfig.defconfig
```kconfig
if SHIELD_MY_KEYBOARD_LEFT

# Name must be less than 16 characters long!
config ZMK_KEYBOARD_NAME
    default "Multi Keyboard"

config ZMK_SPLIT_ROLE_CENTRAL
    default y

endif

if SHIELD_MY_KEYBOARD_LEFT || SHIELD_MY_KEYBOARD_RIGHT

config ZMK_SPLIT
    default y

endif

config CONFIG_ZMK_SPLIT_BLE_CENTRAL_PERIPHERALS
    default 3
```

## boards/shields/multi/Kconfig.shield
```kconfig
# No whitespace after the comma or in the keyboard name!
config SHIELD_MULTI_CONTROL
    def_bool $(shields_list_contains,multi_control)

# No whitespace after the comma or in your part name!
config SHIELD_MULTI_PERIPHERAL_ONE
    def_bool $(shields_list_contains,multi_peripheral_one)

# No whitespace after the comma or in your part name!
config SHIELD_MULTI_PERIPHERAL_TWO
    def_bool $(shields_list_contains,multi_peripheral_two)
```
